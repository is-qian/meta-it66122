## conf/layer.conf
```bitbake
# We have a conf and classes directory, add to BBPATH
BBPATH .= ":${LAYERDIR}"

# We have recipes-* directories, add to BBFILES
BBFILES += "${LAYERDIR}/recipes-*/*/*.bb \
            ${LAYERDIR}/recipes-*/*/*.bbappend"

BBFILE_COLLECTIONS += "meta-it66122"
BBFILE_PATTERN_meta-it66122 = "^${LAYERDIR}/"
BBFILE_PRIORITY_meta-it66122 = "6"

LAYERDEPENDS_meta-it66122 = "core"
LAYERSERIES_COMPAT_meta-it66122 = "scarthgap"

KERNEL_DEVICETREE += " \
    am335x-boneblack-revd.dtb \
  "
```
